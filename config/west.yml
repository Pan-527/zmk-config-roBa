## config/west.yml
```yaml
manifest:
  remotes:
    - name: zmkfirmware
      url-base: https://github.com/zmkfirmware
    - name: kumamuk-git
      url-base: https://github.com/kumamuk-git
    - name: mjmjm0101
      url-base: https://github.com/mjmjm0101
    - name: zettaface
      url-base: https://github.com/zettaface
    - name: kot149
      url-base: https://github.com/kot149
  projects:
    - name: zmk
      remote: zmkfirmware
      revision: v0.3-branch
      import: app/west.yml
    - name: zmk-pmw3610-driver
      remote: kumamuk-git
      revision: main
    # 慣性スクロール (iOS 風のフリックスクロール)
    # 動作確認済みのコミットに固定。更新する場合は revision を差し替える。
    - name: zmk-input-processor-scroll-inertia
      remote: mjmjm0101
      revision: f7dadefee453d555fe066d13a3de3bb60739b45e
    # トラックボールジェスチャー (ボールの動きをキー入力に変換)
    - name: zmk-input-processor-keybind
      remote: zettaface
      revision: 64303bd3932bfa7f49261fc6d0c9a3fdd06f8271
    # スクロールの軸スナップ (縦横どちらか強い方に寄せる)。README の revision v1 はタグが存在しないためコミット固定
    - name: zmk-scroll-snap
      remote: kot149
      revision: dd21a0f71df7f0d2a55017000c6dd0ff0ebd8d6f
  self:
    path: config
```
